## components/aliyun_ota/Kconfig
```kconfig
menu "AliYun OTA Component Configuration"

config AliYun_SUBSCRIBE_TOPIC_OTA_UPGRADE
    string "AliYun Subscribe Topic for OTA Upgrade"
    default "/ota/device/upgrade/k0leyx3kfTE/esp32"
    help
      Topic to subscribe for AliYun OTA upgrade notifications. Update if your AliYun OTA process uses a different path.

config AliYun_PUBLISH_TOPIC_OTA_INFORM
    string "AliYun Publish Topic for OTA Inform"
    default "/ota/device/inform/k0leyx3kfTE/esp32"
    help
      Topic to inform AliYun of OTA process status. Modify if your AliYun OTA reporting requirements differ.

endmenu
```

## components/aliyun_ota/example/components/aliyun_mqtt/Kconfig
```kconfig
menu "AliYun MQTT Component Configuration"

config AliYun_MQTT_HOST_URL
    string "AliYun MQTT Host URL"
    default "mqtt://iot-06z00i8mcbcop1x.mqtt.iothub.aliyuncs.com:1883"
    help
      Specify the AliYun MQTT server URL. Adjust as per your AliYun IoT Platform setup.

config AliYun_MQTT_PORT
    int "AliYun MQTT Port"
    default 1883
    help
      MQTT port for connecting to AliYun IoT Platform. Change only if your AliYun service uses a different port.

config AliYun_MQTT_CLIENT_ID
    string "AliYun MQTT Client ID"
    default "k0leyx3kfTE.esp32|securemode=2,signmethod=hmacsha256,timestamp=1712386756213|"
    help
      Unique client identifier for AliYun MQTT connection. Customize according to your device and AliYun's security requirements.

config AliYun_MQTT_USERNAME
    string "AliYun MQTT Username"
    default "esp32&k0leyx3kfTE"
    help
      Username for AliYun MQTT authentication. Use the credentials provided by AliYun for your device.

config AliYun_MQTT_PASSWORD
    string "AliYun MQTT Password"
    default "1d426f26b55c7884df35d2c560ba65c04f12ee5a7e9a10d8f6c2ff7bafea4339"
    help
      Password for AliYun MQTT authentication. Ensure to use the secure access key assigned by AliYun for your device.

config AliYun_PUBLISH_TOPIC_USER_POST
    string "AliYun Publish Topic for User Post"
    default "/sys/k0leyx3kfTE/esp32/thing/event/property/post"
    help
      Default topic for publishing device events to AliYun. Modify if your AliYun service requires a different topic.

config AliYun_SUBSCRIBE_TOPIC_USER_GET
    string "AliYun Subscribe Topic for User Get"
    default "/k0leyx3kfTE/esp32/user/get"
    help
      Topic to subscribe for receiving user get requests from AliYun. Adjust if your AliYun service uses a different topic.

config AliYun_PUBLISH_TOPIC_USER_UPDATE
    string "AliYun Publish Topic for User Update"
    default "/k0leyx3kfTE/esp32/user/update"
    help
      Topic for sending user updates to AliYun. Customize if your AliYun service has a different topic structure.
 
endmenu
```

## components/aliyun_ota/example/main/Kconfig
```kconfig
menu "My Component Configuration"

config MY_COMPONENT_SUPPORTS_LARGE_FLASH
    bool "Support for large flash sizes (e.g., 16MB)"
    depends on CONFIG_ESPTOOLPY_FLASHSIZE="16MB"

config MY_COMPONENT_USES_DUAL_OTA
    bool "Enable dual OTA partition support"
    default y if CONFIG_PARTITION_TABLE_TWO_OTA

endmenu
```

## components/aliyun_ota/example/sdkconfig.defaults
```kconfig
CONFIG_ESPTOOLPY_FLASHSIZE_16MB=y
CONFIG_ESPTOOLPY_FLASHSIZE="16MB"

#
# Partition Table
#

# CONFIG_PARTITION_TABLE_SINGLE_APP_LARGE is not set
CONFIG_PARTITION_TABLE_TWO_OTA=y  
# CONFIG_PARTITION_TABLE_CUSTOM is not set
CONFIG_PARTITION_TABLE_CUSTOM_FILENAME="partitions.csv"
CONFIG_PARTITION_TABLE_FILENAME="partitions_singleapp.csv"
CONFIG_PARTITION_TABLE_OFFSET=0x8000
CONFIG_PARTITION_TABLE_MD5=y
```
